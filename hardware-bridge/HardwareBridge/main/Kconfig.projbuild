## hardware-bridge/HardwareBridge/main/Kconfig.projbuild
```kconfig
menu "Canine CGM Hardware Bridge Configuration"

    config CGM_WIFI_SSID
        string "WiFi SSID"
        default "myssid"
        help
            WiFi network the bridge connects to reach mobile-bridge.

    config CGM_WIFI_PASSWORD
        string "WiFi password"
        default "mypassword"
        help
            WPA2 password for CGM_WIFI_SSID.

    config CGM_MOBILE_BRIDGE_URL
        string "mobile-bridge base URL"
        default "http://192.168.1.100:9000"
        help
            Base URL of the mobile-bridge service (no trailing slash). This
            firmware POSTs to <this>/telemetry/frame, exactly the same
            endpoint and schema the Python simulator uses.

    config CGM_DOG_ID
        int "Dog ID"
        default 1
        help
            The cloud-backend dog_id this collar reports readings for.
            Single-collar-per-dog for this first prototype.

    config CGM_DEBUG_FRAME_INTERVAL_SECONDS
        int "Debug fake-frame interval (seconds)"
        default 30
        help
            How often to POST a fake TelemetryFrame while no real Libre/Bubble
            sensor is wired up yet (Step 2 of the build plan). Once real BLE
            sensor reads are implemented (Step 3), this debug timer is removed.

    config CGM_ENABLE_BLE_GLUCOMETER
        bool "Enable tier-2 BLE glucometer client"
        default n
        help
            Scans for and connects to a nearby BLE device advertising the
            standard Bluetooth SIG Glucose Service (0x1808), subscribes to
            its Glucose Measurement notifications, and posts each reading
            straight to cloud-backend's POST /readings/device — bypassing
            mobile-bridge entirely, since a glucometer's value is already a
            final mg/dL number with no raw-value/calibration step needed.
            Independent of, and can run alongside, the Step 2 debug loop.

    config CGM_CLOUD_BACKEND_URL
        string "cloud-backend base URL"
        default "http://192.168.1.100:8000"
        help
            Base URL of cloud-backend (no trailing slash). Only used by the
            tier-2 BLE glucometer path (device_reading.cpp), which talks to
            cloud-backend directly rather than through mobile-bridge. Not
            gated behind CGM_ENABLE_BLE_GLUCOMETER — device_reading.cpp is
            compiled unconditionally, so this must always be defined even
            when tier 2 is disabled, the same as CGM_MOBILE_BRIDGE_URL above.

    config CGM_CLOUD_BACKEND_API_KEY
        string "cloud-backend API key (X-API-Key / CGM_SHARED_SECRET)"
        default ""
        help
            Must match cloud-backend's CGM_SHARED_SECRET env var, or every
            POST /readings/device call gets rejected with 401. Same
            always-defined reasoning as CGM_CLOUD_BACKEND_URL above.

endmenu
```
